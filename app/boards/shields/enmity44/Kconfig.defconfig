## app/boards/shields/enmity44/Kconfig.defconfig
```kconfig
if SHIELD_ENMITY44_LEFT

config ZMK_KEYBOARD_NAME
    default "enmity44"

config ZMK_SPLIT_ROLE_CENTRAL
    default y

endif

if SHIELD_ENMITY44_LEFT || SHIELD_ENMITY44_RIGHT

config ZMK_SPLIT
    default y

endif
```

## app/boards/shields/enmity44/Kconfig.shield
```kconfig
config SHIELD_ENMITY44_LEFT
    def_bool $(shields_list_contains,enmity44_left)

config SHIELD_ENMITY44_RIGHT
    def_bool $(shields_list_contains,enmity44_right)
```
